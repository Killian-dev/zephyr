## CMakeLists.txt
```
# SPDX-License-Identifier: Apache-2.0

cmake_minimum_required(VERSION 3.20.0)

find_package(Zephyr REQUIRED HINTS $ENV{ZEPHYR_BASE})
project(hello_world)

target_sources(app PRIVATE src/main.c)

#include_directories(modules/hal/st_bluenrg/bluenrg_family/bluenrglp/drivers/include/rf_driver_ll_rcc.h)
```

## prj.conf
```kconfig
# nothing here

CONFIG_PM=n
CONFIG_PM_DEVICE=n
CONFIG_PM_DEVICE_RUNTIME=n
CONFIG_PM_DEVICE_RUNTIME_EXCLUSIVE=n
#CONFIG_CONFIG_DEVICE_BLUENRG_LP=y
# CONFIG_USE_FULL_LL_DRIVER=y
```

## src/main.c
```c
/*
 * Copyright (c) 2012-2014 Wind River Systems, Inc.
 *
 * SPDX-License-Identifier: Apache-2.0
 */

#include <zephyr/kernel.h>

void main(void)
{
	//printk("Hello World! %s\n", CONFIG_BOARD);
	printk("Hello World!");
}
```
