## boards/arm/st_bluenrglp/Kconfig.board
```kconfig
# BLUENRG-232 board configuration

# SPDX-License-Identifier: Apache-2.0

config BOARD_BLUENRG_LP
	bool "BLUENRG-LP Development Board"
	depends on SOC_BLUENRG_LP
```

## boards/arm/st_bluenrglp/Kconfig.defconfig
```kconfig
# STM32F412G-DISCO board configuration

# SPDX-License-Identifier: Apache-2.0

if BOARD_BLUENRG_LP

config BOARD
	default "bluenrg_lp"

endif # BOARD_BLUENRG_LP
```

## boards/arm/st_bluenrglp/steval_idb011v2_defconfig
```kconfig
# SPDX-License-Identifier: Apache-2.0

# Zephyr Kernel Configuration
CONFIG_SOC_SERIES_BLUENRG=y

# Platform Configuration
CONFIG_SOC_BLUENRG_LP=y

CONFIG_SYS_CLOCK_HW_CYCLES_PER_SEC=120000000

# # Enable MPU
# CONFIG_ARM_MPU=y

# # Serial Drivers
# CONFIG_SERIAL=n
# CONFIG_UART_INTERRUPT_DRIVEN=n
# # enable console
# CONFIG_CONSOLE=n
# CONFIG_UART_CONSOLE=n

# # GPIO Controller
# CONFIG_GPIO=n

# # Enable Clocks
# CONFIG_CLOCK_CONTROL=y

# # enable pin controller
# CONFIG_PINCTRL=n
```

## dts/bindings/gpio/st,bluenrg-gpio.yaml
```yaml
# Copyright (c) 2018, Linaro Limited
# SPDX-License-Identifier: Apache-2.0

description: BLUENRG GPIO node

compatible: "st,bluenrg-gpio"

include: [gpio-controller.yaml, base.yaml]

properties:
    reg:
      required: true

    clocks:
      required: true

    "#gpio-cells":
      const: 2

gpio-cells:
  - pin
  - flags
```

## soc/arm/st_bluenrg/Kconfig
```kconfig
# Copyright (c) 2019 Stephanos Ioannidis <root@stephanos.io>
# SPDX-License-Identifier: Apache-2.0

config SOC_BLUENRG_LP
	bool

config NUM_GPIOS
	int "Upper limit of GPIOS"
```

## soc/arm/st_bluenrg/Kconfig.defconfig
```kconfig
# Copyright (c) 2019 Lexmark International, Inc.
# Copyright (c) 2019 Stephanos Ioannidis <root@stephanos.io>
# SPDX-License-Identifier: Apache-2.0

if SOC_BLUENRG_LP

config SOC
	default "st_bluenrg_lp"

config NUM_IRQS
	default 32

config NUM_GPIOS
	default 32

config PINMUX_BLUENRG_LP
	bool
	default y
	depends on PINMUX

config UART_BLUENRG_LP
	bool
	default y
	depends on SERIAL

config SPI_BLUENRG_LP
	bool
	default y
	
endif # SOC_BLUENRG_LP
```

## soc/arm/st_bluenrg/Kconfig.soc
```kconfig
# Copyright (c) 2019 Lexmark International, Inc.
# Copyright (c) 2019 Stephanos Ioannidis <root@stephanos.io>
# SPDX-License-Identifier: Apache-2.0

config SOC_BLUENRG_LP
	bool "BlueNRG_LP"
	select ARM
	select CPU_CORTEX_M0PLUS
	select SOC_FAMILY_BLUENRG
	select BLUENRG_LP
	select HAS_BLUENRG_HAL
	select CPU_CORTEX_M_HAS_SYSTICK
	select CORTEX_M_SYSTICK
	select SERIAL
	select CLOCK_CONTROL
	select SERIAL_SUPPORT_INTERRUPT
```
