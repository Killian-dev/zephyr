/*
 * Copyright (c) 2017 Powersoft
 *
 * SPDX-License-Identifier: Apache-2.0
 */

/dts-v1/;
#include <st/bluenrg/steval_idb011v2.dtsi>

/ {
	model = "STMicroelectronics BLUENRG_LP-STEVAL_IDB011V2 board";
	compatible = "st,bluenrg_lp-steval_idb011v2";

	chosen {
		zephyr,sram = &sram0;
		zephyr,flash = &flash0;
		zephyr,console = &usart;
		zephyr,shell-uart = &usart;
	};
};

// &usart {
// 	pinctrl-0 = 
// 	pinctrl-names="default";
// 	current-speed = <115200>;
// 	status = "okay";
// };

/*
	leds {
		compatible = "gpio-leds";
		green_led_1: led_1 {
			gpios = <&gpioa 6 GPIO_ACTIVE_HIGH>;
			label = "User LD1";
		};
		green_led_2: led_2 {
			gpios = <&gpiob 8 GPIO_ACTIVE_HIGH>;
			label = "User LD2";
		};
		green_led_3: led_3 {
			gpios = <&gpiob 9 GPIO_ACTIVE_HIGH>;
			label = "User LD3";
		};
	};

	gpio_keys {
		compatible = "gpio-keys";
		user_button1: button1 {
			label = "User Button 1";
			gpios = <&gpioa 10 GPIO_ACTIVE_LOW>;
		};
		user_button2: button2 {
			label = "User Button 2";
			gpios = <&gpiob 6 GPIO_ACTIVE_LOW>;
		};
	};

	aliases {
		led0 = &green_led_1;
		led1 = &green_led_2;
		led2 = &green_led_3;
		sw0 = &user_button1;
		sw1 = &user_button2;
	};
};


&adc1 {
	status = "okay";
};

&spi1 {
	status = "okay";
};
*/
